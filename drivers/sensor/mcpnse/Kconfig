## drivers/sensor/mcpnse/Kconfig
```kconfig
# MCPNSE temperature sensor configuration options

menuconfig MCPNSE
	bool "MCPNSE temperature sensor"
	depends on I2C
	help
	  Enable driver for MCPNSE temperature sensor.

if MCPNSE
config MCPNSE_THREAD_STACK_SIZE
	int "Sensor delayed work thread stack size"
	depends on MCPNSE_TRIGGER_OWN_THREAD
	default 1024

config MCPNSE_THREAD_PRIORITY
	int "MCPNSE thread priority"
	depends on MCPNSE_TRIGGER_OWN_THREAD
	default 10

endif # MCPNSE
```

## dts/bindings/sensor/microchip,mcpnse.yaml
```yaml
description: |
    Microchip MCPNSE Digital Temperature Sensor. See
    http://ww1.microchip.com/downloads/en/DeviceDoc/25095A.pdf.

compatible: "microchip,mcpnse"

include: i2c-device.yaml

properties:
    led-gpios:
      type: phandle-array
      required: false
      description: |
        Pins used for LED

    resolution:
      type: int
      required: false
      default: 3
      description: |
        Sensor resolution. Default is 0.0625C (0b11),
        which is the power-up default.
      enum:
        - 0 # 0.5C
        - 1 # 0.25C
        - 2 # 0.125C
        - 3 # 0.0625C
```
